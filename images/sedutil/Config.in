## images/sedutil/Config.in
```kconfig
source "$BR2_EXTERNAL_SEDUTIL_PATH/package/sedutil-xxc/Config.in"
source "$BR2_EXTERNAL_SEDUTIL_PATH/package/skeleton-sedutil/Config.in"
source "$BR2_EXTERNAL_SEDUTIL_PATH/package/syslinux-sedutil/Config.in"
```

## images/sedutil/configs/sedutil_defconfig
```kconfig
BR2_x86_64=y
BR2_CCACHE=y
BR2_GLOBAL_PATCH_DIR="$(BR2_EXTERNAL_SEDUTIL_PATH)/patches"
BR2_PIC_PIE=y
BR2_PACKAGE_HOST_LINUX_HEADERS_CUSTOM_5_4=y
BR2_UCLIBC_CONFIG="$(BR2_EXTERNAL_SEDUTIL_PATH)/board/uclibc.config"
BR2_TOOLCHAIN_BUILDROOT_USE_SSP=y
# BR2_UCLIBC_INSTALL_UTILS is not set
BR2_TOOLCHAIN_BUILDROOT_CXX=y
BR2_ROOTFS_SKELETON_SEDUTIL=y
BR2_TARGET_GENERIC_PASSWD_SHA512=y
BR2_ROOTFS_DEVICE_TABLE="$(BR2_EXTERNAL_SEDUTIL_PATH)/board/device_table.txt"
BR2_ROOTFS_OVERLAY="$(BR2_EXTERNAL_SEDUTIL_PATH)/board/overlay"
BR2_ROOTFS_POST_IMAGE_SCRIPT="$(BR2_EXTERNAL_SEDUTIL_PATH)/board/build_images.sh"
BR2_ROOTFS_POST_SCRIPT_ARGS="$(BR2_EXTERNAL_SEDUTIL_PATH)/board/layout.sfdisk"
BR2_LINUX_KERNEL=y
BR2_LINUX_KERNEL_CUSTOM_VERSION=y
BR2_LINUX_KERNEL_CUSTOM_VERSION_VALUE="5.4.80"
BR2_LINUX_KERNEL_USE_CUSTOM_CONFIG=y
BR2_LINUX_KERNEL_CUSTOM_CONFIG_FILE="$(BR2_EXTERNAL_SEDUTIL_PATH)/board/kernel.config"
BR2_LINUX_KERNEL_XZ=y
BR2_PACKAGE_BUSYBOX_CONFIG="$(BR2_EXTERNAL_SEDUTIL_PATH)/board/busybox.config"
BR2_TARGET_ROOTFS_CPIO=y
BR2_TARGET_ROOTFS_CPIO_XZ=y
# BR2_TARGET_ROOTFS_TAR is not set
BR2_PACKAGE_HOST_DOSFSTOOLS=y
BR2_PACKAGE_HOST_MTOOLS=y
BR2_PACKAGE_HOST_UTIL_LINUX=y
BR2_PACKAGE_SEDUTIL_XXC=y
BR2_PACKAGE_SYSLINUX_SEDUTIL=y
BR2_PACKAGE_SYSLINUX_SEDUTIL_CONFIG="$(BR2_EXTERNAL_SEDUTIL_PATH)/board/syslinux.cfg"
```

## images/sedutil/package/sedutil-xxc/Config.in
```kconfig
config BR2_PACKAGE_SEDUTIL_XXC
	bool "sedutil (xxc3nsoredxx's fork)"
	depends on BR2_INSTALL_LIBSTDCPP && !BR2_PACKAGE_SEDUTIL
	select BR2_PACKAGE_HOST_DOSFSTOOLS
	select BR2_PACKAGE_HOST_MTOOLS
	select BR2_PACKAGE_HOST_UTIL_LINUX
	help
	  This package provides support for Self Encrypting Drives
	  (SEDs) implementing the Opal 2 standard. This is
	  xxc3nsoredxx's fork of the Drive Trust Alliace's tool.
	  
	  https://DriveTrust.com/
	  https://github.com/xxc3nsoredxx/sedutil

choice
	prompt "sedutil debug level"
	depends on BR2_PACKAGE_SEDUTIL_XXC
	default BR2_PACKAGE_SEDUTIL_XXC_DEBUG_INFO
	help
	  Debug output level. Default is INFO.

config BR2_PACKAGE_SEDUTIL_XXC_DEBUG_ERROR
	bool "ERROR"

config BR2_PACKAGE_SEDUTIL_XXC_DEBUG_WARN
	bool "WARN"

config BR2_PACKAGE_SEDUTIL_XXC_DEBUG_INFO
	bool "INFO"

config BR2_PACKAGE_SEDUTIL_XXC_DEBUG_DEBUG
	bool "DEBUG"

config BR2_PACKAGE_SEDUTIL_XXC_DEBUG_DEBUG1
	bool "DEBUG1"

config BR2_PACKAGE_SEDUTIL_XXC_DEBUG_DEBUG2
	bool "DEBUG2"

config BR2_PACKAGE_SEDUTIL_XXC_DEBUG_DEBUG3
	bool "DEBUG3"

config BR2_PACKAGE_SEDUTIL_XXC_DEBUG_DEBUG4
	bool "DEBUG4"

endchoice

comment "sedutil (xxc3nsoredxx's fork) needs a toolchain w/ C++"
	depends on !BR2_INSTALL_LIBSTDCPP

comment "sedutil (xxc3nsoredxx's fork) is incompatible with sedutil"
	depends on BR2_PACKAGE_SEDUTIL
```

## images/sedutil/package/skeleton-sedutil/Config.in
```kconfig
config BR2_PACKAGE_SKELETON_SEDUTIL
	bool
	select BR2_PACKAGE_HAS_SKELETON

config BR2_PACKAGE_PROVIDES_SKELETON
	default "skeleton-sedutil" if BR2_PACKAGE_SKELETON_SEDUTIL
```

## images/sedutil/package/syslinux-sedutil/Config.in
```kconfig
config BR2_PACKAGE_SYSLINUX_SEDUTIL
	bool "SYSLINUX bootloader"
	depends on !BR2_TARGET_SYSLINUX
	help
	  The SYSLINUX bootloader for 64 bit UEFI systems.
	  
	  https://www.syslinux.org

config BR2_PACKAGE_SYSLINUX_SEDUTIL_CONFIG
	string "syslinux.cfg path"
	depends on BR2_PACKAGE_SYSLINUX_SEDUTIL
	help
	  The path to the SYSLINUX config file

comment "Cannot use included SYSLINUX if using Buildroot SYSLINUX"
	depends on BR2_TARGET_SYSLINUX
```
